/*
 * Copyright (C) 2026 Intel Corporation.
 *
 * SPDX-License-Identifier: BSD-3-Clause
 */

OUTPUT_ARCH(aarch64)
ENTRY(_start)
EXTERN(_start)

SECTIONS
{
	. = CONFIG_HV_RAM_START;

	ld_ram_start = .;

	.text : {
		_text_start = .;
		KEEP(*(.text.entry))
		*(.text)
		*(.text.*)
		*(.note.gnu.build-id)
		. = ALIGN(8);
		_text_end = .;
	}

	. = ALIGN(0x1000);

	.rodata : {
		_rodata_start = .;
		*(.rodata)
		*(.rodata.*)
		. = ALIGN(8);
		_rodata_end = .;
	}

	. = ALIGN(0x1000);

	.rela : {
		*(.rela)
		*(.rela.*)
		*(.dyn*)
	}

	. = ALIGN(0x1000);

	.data : {
		_data_start = .;
		*(.data.page_aligned)
		*(.data)
		*(.data.*)
		. = ALIGN(8);
		_data_end = .;
	}

	. = ALIGN(0x1000);

	.boot_stack : {
		_boot_stack_start = .;
		. += 0x1000;
		. = ALIGN(16);
		_boot_stack_end = .;
	}

	. = ALIGN(0x1000);

	.bss (NOLOAD) : {
		_bss_start = .;
		*(.bss)
		*(.bss.*)
		*(COMMON)
		. = ALIGN(8);
		_bss_end = .;
	}

	. = ALIGN(0x1000);

	ld_ram_end = .;
}
